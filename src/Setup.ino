void setup() {
  cli();
  takeOverTCA0();
  Serial.swap(1);
  Serial.begin(1000000);
  USART0.CTRLB &= ~USART_RXEN_bm; // Disable UART-RX

  pinMode(PG_UPDI, INPUT_PULLUP);
  pinMode(DBG_TXD, OUTPUT);

  pinMode(TSL_LED, OUTPUT);
  pinMode(TSL_CLK, OUTPUT);
  pinMode(TSL_SI , OUTPUT);
  pinMode(TSL_AO , INPUT_PULLUP);
  digitalWrite(TSL_LED, HIGH);
  digitalWrite(TSL_SI , LOW);

  pinMode(OPT_TR , INPUT_PULLUP);
  pinMode(OPT_LED, OUTPUT);
  digitalWrite(OPT_LED, LOW);

  pinMode(TEMP_TH, INPUT);
  pinMode(BATT_VM, INPUT);
  pinMode(HEAT_EN, OUTPUT);
  digitalWrite(HEAT_EN, LOW);

  pinMode(MDRV_LA, OUTPUT);
  pinMode(MDRV_LB, OUTPUT);
  digitalWrite(MDRV_LA, LOW);
  digitalWrite(MDRV_LB, LOW);
  pinMode(MDRV_RA, OUTPUT);
  pinMode(MDRV_RB, OUTPUT);
  digitalWrite(MDRV_RA, LOW);
  digitalWrite(MDRV_RB, LOW);
  pinMode(DRV_PWM, OUTPUT);

  pinMode(TCD_OUT, OUTPUT);
  pinMode(EXT_CLK, INPUT);

  pinMode(NC_SCLK, OUTPUT);
  pinMode(NC_MISO, INPUT_PULLUP);
  pinMode(NC_MOSI, OUTPUT);
  pinMode(LED_OUT, OUTPUT);

  CPUINT.LVL1VEC = ADC0_RESRDY_vect_num;

  VREF.CTRLC  = VREF_ADC1REFSEL_2V5_gc;
  VREF.CTRLA  = VREF_ADC0REFSEL_2V5_gc | VREF_DAC0REFSEL_4V34_gc;
  VREF.CTRLD  =                          VREF_DAC2REFSEL_4V34_gc;
  VREF.CTRLB |= VREF_ADC0REFEN_bm;
  VREF.CTRLB |= VREF_ADC1REFEN_bm;
  VREF.CTRLB |= VREF_DAC0REFEN_bm;
  VREF.CTRLB |= VREF_DAC2REFEN_bm;

  ADC0.MUXPOS   = ADC0_AINMUX;
  ADC0.SAMPCTRL = 0;
  ADC0.CTRLA    = ADC_RESSEL_8BIT_gc | ADC_FREERUN_bm;
  ADC0.CTRLB    = ADC_SAMPNUM_ACC1_gc;
  ADC0.CTRLC    = ADC_PRESC_DIV8_gc | ADC_SAMPCAP_bm | ADC_REFSEL_INTREF_gc;
  ADC0.CTRLD    = ADC_INITDLY_DLY0_gc | ADC_ASDV_ASVOFF_gc;
  ADC0.CALIB    = ADC_DUTYCYC_bp;
  ADC0.EVCTRL   = ADC_STARTEI_bm;
  ADC0.INTFLAGS = ADC_RESRDY_bm;
  ADC0.INTCTRL  = ADC_RESRDY_bm;
  ADC0.CTRLA   |= ADC_ENABLE_bm;

  CCL.SEQCTRL0   = CCL_SEQSEL_DISABLE_gc;

  PORTMUX.CTRLA |= PORTMUX_LUT0_bm;
  CCL.LUT0CTRLB  = CCL_INSEL0_TCA0_gc; // TCA0
  CCL.LUT0CTRLB |= CCL_INSEL1_TCB0_gc; // TCB0
  CCL.LUT0CTRLC  = CCL_INSEL2_MASK_gc;
  CCL.TRUTH0     = 0b00100010;
  CCL.LUT0CTRLA |= CCL_ENABLE_bm | CCL_OUTEN_bm;

  CCL.LUT1CTRLB  = CCL_INSEL0_SPI0_gc; // SCK
  CCL.LUT1CTRLB |= CCL_INSEL1_SPI0_gc; // MOSI
  CCL.LUT1CTRLC  = CCL_INSEL2_TCB1_gc; // TCB1
  CCL.TRUTH1     = 0b11001010;
  CCL.LUT1CTRLA |= CCL_ENABLE_bm | CCL_OUTEN_bm;

  CCL.CTRLA     |= CCL_ENABLE_bm;

  EVSYS.ASYNCCH1 = EVSYS_ASYNCCH1_RTC_CMP_gc;
  EVSYS.SYNCUSER0  = EVSYS_SYNCUSER0_SYNCCH1_gc; // TCA0
  EVSYS.ASYNCUSER0 = EVSYS_ASYNCUSER0_ASYNCCH1_gc; // TCB0
  EVSYS.ASYNCUSER1 = EVSYS_ASYNCUSER1_ASYNCCH1_gc; // ADC0

  TCA0.SINGLE.PER      = PIXEL_NUM;
  TCA0.SINGLE.CNT      = TCA0.SINGLE.PER;
  TCA0.SINGLE.CMP0     = TCA0.SINGLE.PER;
  TCA0.SINGLE.CTRLB    = TCA_SINGLE_WGMODE_SINGLESLOPE_gc;
  TCA0.SINGLE.EVCTRL   = TCA_SINGLE_CNTEI_bm;
  TCA0.SINGLE.INTFLAGS = TCA_SINGLE_CMP0_bm;
  TCA0.SINGLE.INTCTRL  = TCA_SINGLE_CMP0_bm;
  TCA0.SINGLE.CTRLA    = TCA_SINGLE_ENABLE_bm;

  /* ADC Clock Prescaler(8) * Half of ADC Conversion Tick - Count Start Delay */
  TCB0.CCMP   = (8 * 13) / 2 - 2;
  TCB0.CNT    = TCB0.CCMP;
  TCB0.CTRLB  = TCB_CNTMODE_SINGLE_gc | TCB_ASYNC_bm;
  TCB0.EVCTRL = TCB_CAPTEI_bm;
  TCB0.CTRLA  = TCB_ENABLE_bm;

  while (RTC.STATUS & RTC_PERBUSY_bm);
  RTC.PER      = ExposureTick;
  while (RTC.STATUS & RTC_CMPBUSY_bm);
  RTC.CMP      = 1;
  while (RTC.STATUS & RTC_CNTBUSY_bm);
  RTC.CNT      = 2;
  RTC.CLKSEL   = RTC_CLKSEL_EXTCLK_gc;
  RTC.INTFLAGS = RTC_OVF_bm;
  RTC.INTCTRL  = RTC_OVF_bm;
  while (RTC.STATUS & RTC_CTRLABUSY_bm);
  RTC.CTRLA    = RTC_RTCEN_bm;

  RTC.PITINTCTRL = RTC_PI_bm;
  while (RTC.PITSTATUS & RTC_CTRLBUSY_bm);
  RTC.PITCTRLA   = RTC_PERIOD_CYC8192_gc | RTC_PITEN_bm;

  EVSYS.ASYNCCH3 = EVSYS_ASYNCCH3_TCD0_CMPASET_gc;
  EVSYS.ASYNCUSER8 = EVSYS_ASYNCUSER8_ASYNCCH3_gc; // EVOUT0
  PORTMUX.CTRLA |= PORTMUX_EVOUT0_bm;

  EVSYS.ASYNCUSER6 = EVSYS_ASYNCUSER6_OFF_gc; // TCD0

  TCD0.CTRLA = TCD_CLKSEL_SYSCLK_gc;
  TCD0.CTRLB = TCD_WGMODE_ONERAMP_gc;
  TCD0.CTRLC = TCD_AUPDATE_bm | TCD_CMPOVR_bm;
  TCD0.EVCTRLA = TCD_ACTION_FAULT_gc | TCD_EDGE_FALL_LOW_gc | TCD_TRIGEI_bm;
  TCD0.EVCTRLB = TCD_CFG_NEITHER_gc;
  TCD0.INPUTCTRLA = TCD_INPUTMODE_LVLTRIGFREQ_gc;
  TCD0.INPUTCTRLB = TCD_INPUTMODE_NONE_gc;
  TCD0.DLYCTRL = TCD_DLYSEL_INBLANK_gc | TCD_DLYPRESC_DIV1_gc | TCD_DLYTRIG_CMPBSET_gc;
  TCD0.DLYVAL = 32 - 1;
  CCP = CCP_IOREG_gc;
  TCD0.FAULTCTRL = TCD_CMPA_bm | TCD_CMPAEN_bm;
  TCD0.CMPASET = 0;
  TCD0.CMPACLR = 0;
  TCD0.CMPBSET = 0;
  TCD0.CMPBCLR = 32 - 1; // 500kHz
  while (!(TCD0.STATUS & TCD_ENRDY_bm));
  TCD0.CTRLA |= TCD_ENABLE_bm;

  PORTMUX.CTRLB |= PORTMUX_SPI0_bm;
  SPI0.CTRLA  = SPI_MASTER_bm | SPI_PRESC_DIV16_gc; // 1MHz
  SPI0.CTRLB  = SPI_MODE_1_gc | SPI_BUFEN_bm | SPI_BUFWR_bm | SPI_SSD_bm;
  SPI0.CTRLA |= SPI_ENABLE_bm;

  EVSYS.SYNCCH0 = EVSYS_SYNCCH0_PORTC_PIN0_gc; // SCK-PIN
  EVSYS.ASYNCUSER11 = EVSYS_ASYNCUSER11_SYNCCH0_gc; // TCB1

  TCB1.CCMP   = 2;
  TCB1.CNT    = TCB1.CCMP;
  TCB1.CTRLB  = TCB_CNTMODE_SINGLE_gc;
  TCB1.EVCTRL = TCB_CAPTEI_bm;
  TCB1.CTRLA  = TCB_ENABLE_bm;

  ADC1.MUXPOS   = ADC1_AINMUX;
  ADC1.SAMPCTRL = 0;
  ADC1.CTRLA    = ADC_RESSEL_8BIT_gc | ADC_FREERUN_bm;
  ADC1.CTRLB    = ADC_SAMPNUM_ACC1_gc;
  ADC1.CTRLC    = ADC_PRESC_DIV256_gc | ADC_REFSEL_INTREF_gc;
  ADC1.CTRLD    = ADC_INITDLY_DLY16_gc | ADC_ASDV_ASVON_gc;
  ADC1.CALIB    = ADC_DUTYCYC_bm;
  ADC1.INTFLAGS = ADC_RESRDY_bm;
  ADC1.INTCTRL  = ADC_RESRDY_bm;
  ADC1.CTRLA   |= ADC_ENABLE_bm;
  ADC1.COMMAND  = ADC_STCONV_bm;

  DAC2.CTRLA = DAC_ENABLE_bm;
  DAC2.DATA  = 0xFF;
  AC2.MUXCTRLA = (AC2_AINPMUX << AC_MUXPOS_gp) | AC_MUXNEG_DAC_gc;
  AC2.CTRLA    = AC_HYSMODE_50mV_gc | AC_OUTEN_bm | AC_ENABLE_bm;

  DAC0.CTRLA = DAC_ENABLE_bm;
  DAC0.DATA  = (unsigned char)(255.0 * LowBatteryThreshold / 4.34);
  AC0.MUXCTRLA = (AC0_AINPMUX << AC_MUXPOS_gp) | AC_MUXNEG_DAC_gc | AC_INVERT_bm;
  AC0.CTRLA    = AC_HYSMODE_50mV_gc | AC_ENABLE_bm;

  sei();

  Heater_OFF();
  MotorPower(MOTOR_ON);
  digitalWriteFast(OPT_LED, LOW);
  LED_Left(0, 0, 0);
  LED_Right(0, 0, 0);
  ledUpdate();
  currentMode = MODE_AWAKENING;
}
